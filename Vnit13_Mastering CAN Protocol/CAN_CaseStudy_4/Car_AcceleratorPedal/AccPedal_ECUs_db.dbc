VERSION ""

NS_ :

BS_:

BU_: ECU2_SPEED_SENSOR ECU1_ACC_CMD

BO_ 939 SpeedVAL_Message: 1 ECU2_SPEED_SENSOR
 SG_ SpeedVAL_Signal : 0|8@1+ (1,0) [0|255] ""  ECU1_ACC_CMD

BO_ 48 ACC_CMD_Message: 1 ECU1_ACC_CMD
 SG_ ACC_CMD_Signal : 0|8@1+ (1,0) [0|1] ""  ECU2_SPEED_SENSOR
